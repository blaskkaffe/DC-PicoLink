/*
 * RP2040 USB <-> Dreamcast serial ("coder's cable") + W5500 emulator (see README.md)
 * Core0: USB (CDC-ACM serial + CDC-NCM network), UART bridge. Core1: spi_slave.c
 *
 * Wiring (via DC SD Adapter V2, SD-card pin names -> Dreamcast SCIF signal):
 *   GPIO2  SD CLK   = DC CTS  (DC input)  -- sense only; driven from GPIO6 via 1k
 *   GPIO3  SD CMD   = DC TXD  (DC output) -> our RX
 *   GPIO4  SD DAT0  = DC RXD  (DC input)  <- our TX
 *   GPIO5  SD DAT3  = DC RTS  (DC output) -> our CTS (flow control input)
 *   GPIO6  ---[1k]--- GPIO2   our RTS output -> DC CTS
 *   GND    SD VSS   = DC GND
 *
 * The 1k resistor protects against contention: KallistiOS' SD-over-serial driver
 * drives DC CTS as an output (SPI clock). GPIO2 is therefore left as an input.
 *
 * Baud rates: whatever the host requests is generated by PIO. With DC_BAUD_MATCH
 * enabled the rate is rounded exactly like dcload-serial/KOS program the SCIF
 * (SCBRR = 50MHz/(32*baud) - 1, truncated), so the adapter runs at precisely the
 * rate the Dreamcast actually uses (only above 115200; 115200 and below are
 * generated exactly, like FTDI/CP210x adapters): 230400 -> 260416,
 * 500000 -> 520833, 1500000 -> 1562500, and DC-native rates (1562500, 781250,
 * 520833, 390625, 312500, 260416, 223214, 111607...) map to themselves.
 * Above 1562500 dcload's 8-bit divider wraps (0 - 1 = 255): -b 1600000 really
 * puts the DC at 6103 baud, so the cable does the same and logs a hint
 * (baud_model.h).
 */

#include <string.h>
#include <math.h>
#include "pico/stdlib.h"
#include "pico/bootrom.h"
#include "hardware/pio.h"
#include "hardware/dma.h"
#include "hardware/clocks.h"
#include "w5500_spi.pio.h"
#include "hardware/sync.h"
#include "hardware/irq.h"
#include "hardware/vreg.h"
#include "tusb.h"
#include "pico/multicore.h"
#include "uart.pio.h"
#include "dcmode.h"
#define W5_PUSH(b) ((void)(b))
#include "w5500_model.h"

/* SD card backend link (USB vendor bulk interface <-> dcsd daemon on the Pi) */
static bool sd_link_up;
static bool host_write(const void *p, uint32_t n) {
    if (!tud_mounted() || tud_vendor_write_available() < n) return false;
    tud_vendor_write(p, n);
    return true;
}
#define HOST_WRITE(p, n)   host_write((p), (n))
#define HOST_WRITE_AVAIL() (tud_mounted() ? tud_vendor_write_available() : 0u)
#define SD_PUSH(b)       ((void)(b))     /* card-side helpers live on core1 */
#define SD_DMA(b, l)     ((void)(b), (void)(l))
#define SD_DMA_BUSY()    false
#define SD_FLUSH()       ((void)0)
#define SD_FILL(v)       ((void)(v))
static volatile uint8_t force_req = 0xFF;
#define SDH_MODE_HOOK(v) (force_req = (v))
static volatile bool cap_req;
#define SDH_CAPTURE_HOOK(v) ((void)(v), cap_req = true)
#include "sd_model.h"

/* ---- configuration ---------------------------------------------------- */

#ifndef DC_BAUD_MATCH
#define DC_BAUD_MATCH     1   /* round baud the same way the Dreamcast does */
#endif
#define DEFAULT_BAUD      57600

#define RX_BITS           14                       /* ring size in bytes (DMA ring) */
#define RX_WORDS          (1u << (RX_BITS - 2))    /* 4096 characters, 1 word each */
#define RX_STOP_LEVEL     (RX_WORDS * 3 / 4)       /* deassert RTS above   */
#define RX_GO_LEVEL       (RX_WORDS / 4)           /* reassert RTS below   */
#define TX_CHUNK          1024                     /* USB->DC DMA chunk    */

/* ---- state ------------------------------------------------------------ */
PIO uart_pio = pio0;
uint uart_sm_tx, uart_sm_rx, uart_off_tx, uart_off_rx;
static int dma_rx, dma_tx;

static uint32_t rx_ring[RX_WORDS] __attribute__((aligned(1u << RX_BITS)));  /* 3x-sampled chars */
static volatile uint32_t rx_base;       /* words written by completed DMA runs */
static uint32_t rx_rd;                  /* words consumed                       */
static bool rts_asserted;

static uint8_t tx_buf[2][TX_CHUNK];
static int tx_cur = 0;

static uint32_t cur_baud = 0;             /* rate the host (DreamPi, dc-tool) asked for */
static float wire_baud = 0;               /* rate actually on the wire */
static float auto_baud = 0;               /* != 0: following the DC's measured rate */
static uint32_t baud_holdoff_until;       /* no auto-follow right after a host change */
static uint meter_sm;
static volatile uint32_t pending_baud = 0;   /* 0 = none */
static volatile uint32_t pending_old_bytes;  /* bytes to send at the old rate */

/* ---- baud ------------------------------------------------------------- */
#include "baud_model.h"

static void set_wire_baud(float baud) {
    float div = (float)clock_get_hz(clk_sys) / (8.0f * baud);
    if (div < 1.0f) div = 1.0f;
    if (div > 65535.0f) div = 65535.0f;
    pio_sm_set_clkdiv(uart_pio, uart_sm_tx, div);
    pio_sm_set_clkdiv(uart_pio, uart_sm_rx, div / 2.0f);     /* RX: 16 clocks/bit */
    pio_clkdiv_restart_sm_mask(uart_pio, (1u << uart_sm_tx) | (1u << uart_sm_rx));
    wire_baud = baud;
}

/* Host-requested rate change: drops any auto-follow (a real speed change, e.g.
   dc-tool-ser switching to 1562500, must win). */
static void apply_baud(uint32_t req) {
    auto_baud = 0;
    set_wire_baud(dc_effective_baud(req));
    cur_baud = req;
    baud_holdoff_until = time_us_32() + 1500000u;
}

/* ---- RX DMA (PIO RX FIFO -> ring) -------------------------------------- */
static void dma_rx_irq(void) {
    if (dma_channel_get_irq0_status(dma_rx)) {
        dma_channel_acknowledge_irq0(dma_rx);
        rx_base += 0xFFFFFFFFu;
        dma_channel_set_trans_count(dma_rx, 0xFFFFFFFFu, true);  /* keep going */
    }
}

static uint32_t rx_written(void) {
    uint32_t s = save_and_disable_interrupts();
    uint32_t w = rx_base + (0xFFFFFFFFu - dma_hw->ch[dma_rx].transfer_count);
    restore_interrupts(s);
    return w;
}

static void set_rts(bool assert) {
    rts_asserted = assert;
    rts_stamp = time_us_32();           /* tell core1 this edge is ours */
    gpio_put(PIN_RTS, assert ? 0 : 1);   /* active low */
}

/* ---- setup ------------------------------------------------------------ */
static void serial_init(void) {
    /* RTS out (through 1k into DC CTS); GPIO2 stays a plain input */
    gpio_init(PIN_DC_CTS_SENSE);
    gpio_set_dir(PIN_DC_CTS_SENSE, GPIO_IN);
    gpio_pull_down(PIN_DC_CTS_SENSE);   /* weak; keeps the sense input defined while offline */
    gpio_init(PIN_RTS);                 /* stays an input until core1 goes online */
    gpio_disable_pulls(PIN_RTS);
    gpio_put(PIN_RTS, 0);
    rts_asserted = true;

    /* CTS in (DC RTS): pull-down so an undriven line means "clear to send" */
    gpio_init(PIN_CTS);
    gpio_set_dir(PIN_CTS, GPIO_IN);
    gpio_pull_down(PIN_CTS);

    /* TX state machine */
    uart_sm_tx = pio_claim_unused_sm(uart_pio, true);
    uart_off_tx = pio_add_program(uart_pio, &uart_tx_program);
    pio_sm_set_pins_with_mask(uart_pio, uart_sm_tx, 1u << PIN_TX, 1u << PIN_TX);
    pio_sm_set_pindirs_with_mask(uart_pio, uart_sm_tx, 1u << PIN_TX, 1u << PIN_TX);
    pio_gpio_init(uart_pio, PIN_TX);
    pio_sm_config c = uart_tx_program_get_default_config(uart_off_tx);
    sm_config_set_out_shift(&c, true, false, 32);
    sm_config_set_out_pins(&c, PIN_TX, 1);
    sm_config_set_sideset_pins(&c, PIN_TX);
    sm_config_set_in_pins(&c, PIN_CTS);
    sm_config_set_fifo_join(&c, PIO_FIFO_JOIN_TX);
    pio_sm_init(uart_pio, uart_sm_tx, uart_off_tx, &c);

    /* RX state machine. Pull-DOWN: never put voltage on a DC pin ourselves, and
       lets core1 see whether the DC is driving its TXD (idle high) */
    uart_sm_rx = pio_claim_unused_sm(uart_pio, true);
    uart_off_rx = pio_add_program(uart_pio, &uart_rx_program);
    pio_sm_set_consecutive_pindirs(uart_pio, uart_sm_rx, PIN_RX, 1, false);
    pio_gpio_init(uart_pio, PIN_RX);
    gpio_pull_down(PIN_RX);
    c = uart_rx_program_get_default_config(uart_off_rx);
    sm_config_set_in_pins(&c, PIN_RX);
    sm_config_set_jmp_pin(&c, PIN_RX);
    sm_config_set_in_shift(&c, true, false, 32);
    sm_config_set_fifo_join(&c, PIO_FIFO_JOIN_RX);
    pio_sm_init(uart_pio, uart_sm_rx, uart_off_rx, &c);

    /* DC TXD pulse meter (auto-baud / diagnostics), full system clock */
    meter_sm = pio_claim_unused_sm(uart_pio, true);
    uint off_m = pio_add_program(uart_pio, &dc_tx_meter_program);
    c = dc_tx_meter_program_get_default_config(off_m);
    sm_config_set_in_pins(&c, PIN_RX);
    sm_config_set_jmp_pin(&c, PIN_RX);
    pio_sm_init(uart_pio, meter_sm, off_m, &c);
    pio_sm_set_enabled(uart_pio, meter_sm, true);

    apply_baud(DEFAULT_BAUD);

    /* RX DMA: byte reads from the top byte of the RX FIFO into a ring buffer */
    dma_rx = dma_claim_unused_channel(true);
    dma_channel_config dc = dma_channel_get_default_config(dma_rx);
    channel_config_set_transfer_data_size(&dc, DMA_SIZE_32);
    channel_config_set_read_increment(&dc, false);
    channel_config_set_write_increment(&dc, true);
    channel_config_set_ring(&dc, true, RX_BITS);
    channel_config_set_dreq(&dc, pio_get_dreq(uart_pio, uart_sm_rx, false));
    dma_channel_configure(dma_rx, &dc, rx_ring, &uart_pio->rxf[uart_sm_rx],
                          0xFFFFFFFFu, false);
    dma_channel_set_irq0_enabled(dma_rx, true);
    irq_set_exclusive_handler(DMA_IRQ_0, dma_rx_irq);
    irq_set_enabled(DMA_IRQ_0, true);

    /* TX DMA: buffer -> PIO TX FIFO */
    dma_tx = dma_claim_unused_channel(true);
    dc = dma_channel_get_default_config(dma_tx);
    channel_config_set_transfer_data_size(&dc, DMA_SIZE_8);
    channel_config_set_read_increment(&dc, true);
    channel_config_set_write_increment(&dc, false);
    channel_config_set_dreq(&dc, pio_get_dreq(uart_pio, uart_sm_tx, true));
    dma_channel_configure(dma_tx, &dc, &uart_pio->txf[uart_sm_tx], tx_buf[0], 0, false);

    dma_channel_start(dma_rx);
    /* Start OFFLINE: SMs stay disabled and TX is a plain high-Z input until core1
       decides the Dreamcast is up (see DC_POWER_PIN in dcmode.h). */
    gpio_init(PIN_TX);
    gpio_disable_pulls(PIN_TX);
    /* GPIO4 drives DC RXD (serial TX and SPI MISO) through the adapter. It
       stays at the SDK default pad (slow slew, 4 mA): net7 tried fast slew and
       8 mA, and every cable->DC path broke now and then (DreamShell crashed
       reading the SD card, RuneScape's RX pointer slipped, 23 Oct). Back on the
       default (the net7r A/B build) RuneScape ran clean. */
}

/* ---- USB -> DC -------------------------------------------------------- */
static void usb_to_dc(void) {
    if (dma_channel_is_busy(dma_tx))
        return;

    uint32_t limit = TX_CHUNK;
    if (pending_baud) {
        if (pending_old_bytes == 0) {
            /* everything for the old rate is queued; wait for the wire to go idle */
            if (!pio_sm_is_tx_fifo_empty(uart_pio, uart_sm_tx)) return;
            float bit_us = 1e6f / wire_baud;
            sleep_us((uint32_t)(bit_us * 11.0f) + 2);
            apply_baud(pending_baud);
            pending_baud = 0;
            return;
        }
        if (limit > pending_old_bytes) limit = pending_old_bytes;
    }

    uint32_t n = tud_cdc_available() ? tud_cdc_read(tx_buf[tx_cur], limit) : 0;
    if (!n) return;
    if (pending_baud) pending_old_bytes -= n;
    dma_channel_transfer_from_buffer_now(dma_tx, tx_buf[tx_cur], n);
    tx_cur ^= 1;
}

/* majority of 3 samples per bit -> byte; stop bit is bit 31 */
static uint32_t rx_fe_count, rx_overruns;            /* framing errors (bad stop bit / break) */
static inline bool rx_ok(uint32_t w) { return w >> 31; }
static inline uint8_t rx_decode(uint32_t w) {
    static const uint8_t maj = 0xE8;            /* bit k set if popcount(k) >= 2 */
    uint8_t b = 0;
    w >>= 7;
    for (int i = 0; i < 8; i++, w >>= 3) b |= (uint8_t)(((maj >> (w & 7)) & 1) << i);
    return b;
}

/* ---- PPP frame check on DC -> host data (diagnostics) ------------------
   Async HDLC: frames between 0x7E flags, 0x7D escapes, FCS-16 good value 0xF0B8.
   Tells whether frames are already damaged when they reach the cable (wire /
   sampling problem) or only later (USB / host side). For damaged frames it also
   works out what kind of damage it is:
   - "split votes": bits whose 3 samples disagreed (noise / slow edges)
   - frame length vs the length field inside the packet (missing bytes)
   - the single flipped bit that would fix the checksum, if there is one */
#if DC_DIAG
#define PPM_MAX 2048
static struct {
    uint16_t fcs; uint8_t esc;
    uint32_t len, wlen, good, bad, dropped, split;
    uint8_t b[PPM_MAX];            /* unescaped bytes of the current frame      */
    uint32_t w[PPM_MAX];           /* raw 3x-sampled word each byte came from   */
    uint32_t chars, split_chars, split_bits;    /* totals for the 10 s report   */
} ppm;
static char ppm_rep[2][200];
static volatile uint8_t ppm_nrep;
static uint32_t ppm_rep_dropped;

static inline uint32_t split_bits(uint32_t w) {        /* data bits whose samples disagree */
    uint32_t n = 0; w >>= 7;
    for (int i = 0; i < 8; i++, w >>= 3) { uint32_t t = w & 7; n += (t != 0 && t != 7); }
    return n;
}
static inline uint16_t fcs_step0(uint16_t r) { return (r & 1) ? (uint16_t)((r >> 1) ^ 0x8408) : (uint16_t)(r >> 1); }

static void ppm_analyse(void) {
    if (ppm_nrep >= 2) { ppm_rep_dropped++; return; }
    char *t = ppm_rep[ppm_nrep];
    uint32_t L = ppm.len < PPM_MAX ? ppm.len : PPM_MAX;
    const uint8_t *b = ppm.b;
    int o = snprintf(t, 200, "bad frame: %lu bytes", (unsigned long)ppm.len);
    /* length field: [FF 03] proto(1|2) then IP / LCP / IPCP / PAP length at +2 */
    uint32_t i = (L >= 2 && b[0] == 0xFF && b[1] == 0x03) ? 2 : 0, proto = 0;
    if (i < L) { if (b[i] & 1) proto = b[i++]; else if (i + 1 < L) { proto = (uint32_t)b[i] << 8 | b[i + 1]; i += 2; } }
    if ((proto == 0x21 || proto == 0xC021 || proto == 0x8021 || proto == 0xC023) && i + 3 < L) {
        uint32_t pl = (uint32_t)b[i + 2] << 8 | b[i + 3];
        o += snprintf(t + o, 200 - o, " (proto %04lx says %lu)", (unsigned long)proto, (unsigned long)(i + pl + 2));
    } else
        o += snprintf(t + o, 200 - o, " (proto %04lx)", (unsigned long)proto);
    o += snprintf(t + o, 200 - o, ", %lu split votes, %lu dropped chars",
                  (unsigned long)ppm.split, (unsigned long)ppm.dropped);
    /* single-bit error search: residue difference of a flip k bits from the end */
    uint16_t d = ppm.fcs ^ 0xF0B8, r = 0x8408;
    uint32_t nb = L * 8, k;
    for (k = 0; k < nb && r != d; k++) r = fcs_step0(r);
    if (k < nb && ppm.len <= PPM_MAX) {
        uint32_t byte = L - 1 - k / 8, bit = 7 - k % 8, wd = ppm.w[byte] >> (7 + 3 * bit) & 7;
        o += snprintf(t + o, 200 - o, "; 1-bit fix: byte %lu bit %lu %02x->%02x samples %lu%lu%lu, near",
                      (unsigned long)byte, (unsigned long)bit, b[byte], b[byte] ^ (1u << bit),
                      (unsigned long)(wd & 1), (unsigned long)(wd >> 1 & 1), (unsigned long)(wd >> 2));
        for (uint32_t j = byte >= 3 ? byte - 3 : 0; j < L && j <= byte + 3 && o < 190; j++)
            o += snprintf(t + o, 200 - o, " %02x", b[j]);
    } else {
        o += snprintf(t + o, 200 - o, "; no 1-bit fix, starts");
        for (uint32_t j = 0; j < L && j < 12 && o < 190; j++) o += snprintf(t + o, 200 - o, " %02x", b[j]);
    }
    ppm_nrep++;
}

static void ppm_char(uint32_t wd, bool ok) {
    if (!ok) { ppm.dropped++; return; }
    uint8_t c = rx_decode(wd);
    uint32_t sb = split_bits(wd);
    ppm.chars++; if (sb) { ppm.split_chars++; ppm.split_bits += sb; }
    if (c == 0x7E) {
        if (ppm.len >= 4) {
            if (ppm.fcs == 0xF0B8) ppm.good++;
            else { ppm.bad++; ppm_analyse(); }
        }
        ppm.len = 0; ppm.fcs = 0xFFFF; ppm.esc = 0; ppm.dropped = 0; ppm.split = 0;
        return;
    }
    ppm.split += sb;
    if (c == 0x7D) { ppm.esc = 1; return; }
    if (ppm.esc) { c ^= 0x20; ppm.esc = 0; }
    uint16_t f = ppm.fcs ^ c;
    for (int i = 0; i < 8; i++) f = (f & 1) ? (uint16_t)((f >> 1) ^ 0x8408) : (uint16_t)(f >> 1);
    ppm.fcs = f;
    if (ppm.len < PPM_MAX) { ppm.b[ppm.len] = c; ppm.w[ppm.len] = wd; }
    if (ppm.len < 0x10000) ppm.len++;
}
#endif

/* ---- DC -> USB -------------------------------------------------------- */
static void dc_to_usb(void) {
    uint32_t w = rx_written();
    uint32_t used = w - rx_rd;
    if (used > RX_WORDS) {              /* overrun (only without flow control) */
        rx_overruns++;
        rx_rd = w - RX_WORDS / 2;
        used = RX_WORDS / 2;
    }

    if (used && tud_cdc_connected()) {
        uint8_t buf[64];
        uint32_t room = tud_cdc_write_available();
        while (used && room) {
            uint32_t take = used < sizeof buf ? used : sizeof buf;
            if (take > room) take = room;
            uint32_t n = 0;
            for (uint32_t i = 0; i < take; i++) {
                uint32_t wd = rx_ring[(rx_rd + i) & (RX_WORDS - 1)];
                bool ok = rx_ok(wd);
                if (ok) buf[n++] = rx_decode(wd);
                else rx_fe_count++;             /* framing error / break: drop */
#if DC_DIAG
                ppm_char(wd, ok);
#endif
            }
            if (n && tud_cdc_write(buf, n) != n) break;   /* room was checked */
            rx_rd += take; used -= take; room -= n;
        }
        tud_cdc_write_flush();
    } else if (used && !tud_cdc_connected()) {
        for (; rx_rd != w; rx_rd++)     /* nobody listening: discard (keep stats) */
            if (!rx_ok(rx_ring[rx_rd & (RX_WORDS - 1)])) rx_fe_count++;
        used = 0;
    }

    if (rts_asserted && used > RX_STOP_LEVEL) set_rts(false);
    else if (!rts_asserted && used < RX_GO_LEVEL) set_rts(true);
}

/* ---- TinyUSB callbacks ------------------------------------------------ */
void tud_cdc_line_coding_cb(uint8_t itf, cdc_line_coding_t const *lc) {
    if (itf != 0) return;               /* only the coder's-cable port has a baud rate */
    uint32_t b = lc->bit_rate;
    if (b == 0 || b == cur_baud) { pending_baud = 0; return; }
    if (dc_mode != MODE_SERIAL) { pending_baud = 0; apply_baud(b); return; }
    /* bytes already received over USB belong to the old rate (dc-tool sends the
       new speed and reopens the port immediately) */
    pending_old_bytes = tud_cdc_available();
    pending_baud = b;
}

/* No 1200-baud "touch" to BOOTSEL: 1200 is an ordinary rate here, and a test tool or terminal that
   sets it must not reboot the cable. BOOTSEL is the button. */
void tud_cdc_line_state_cb(uint8_t itf, bool dtr, bool rts) {
    (void)itf; (void)dtr; (void)rts;
}

static void status(const char *fmt, ...) __attribute__((format(printf, 1, 2)));

#ifndef DC_CONSOLE_BAUD
#define DC_CONSOLE_BAUD (50e6f / (32.0f * 14.0f))   /* SCBRR 13 for 115200 */
#endif
/* ---- mode changes made by core1 --------------------------------------- */
static int seen_mode = MODE_SERIAL;

static void track_mode(void) {
    int m = dc_mode;
    if (m == seen_mode) return;
    static const char *const names[] = { "serial", "SPI (SD/W5500)", "offline (DC off or not started)" };
    status("mode: %s -> %s", names[seen_mode], names[m]);
    seen_mode = m;
    static float saved_baud;
    if (m == MODE_W5500) {            /* listen to the DC's console (KOS: 115200 = 111607 real) */
        saved_baud = wire_baud;
        set_wire_baud(DC_CONSOLE_BAUD);
        rx_rd = rx_written();
    } else if (saved_baud != 0) {
        set_wire_baud(saved_baud);
        saved_baud = 0;
    }
    if (m != MODE_SERIAL) {
        /* serial path is dead (W5500 or DC off): flush everything queued for the DC UART */
        dma_channel_abort(dma_tx);
        pio_sm_clear_fifos(uart_pio, uart_sm_tx);
        pending_baud = 0;
    } else {
        /* back to serial: drop whatever the RX DMA picked up meanwhile */
        rx_rd = rx_written();
        rts_asserted = true;          /* core1 re-asserted RTS */
    }
}

/* ---- DC console while in SPI mode ---------------------------------------
   KOS prints its debug log (dbglog) on the serial port whenever SCIF-SPI is
   shut down, e.g. between the W5500 driver's probe and its init. The UART
   receiver keeps listening in SPI mode; clean text lines are passed to the Pi
   log as "dc console: ...". SPI traffic on the same wire decodes as junk and
   is dropped (a line must be printable from start to end). */
static void console_task(void) {
    static char line[128];
    static uint32_t n, last, sent_t, sent_n;
    static bool junk;
    uint32_t now = time_us_32();
    if (seen_mode != MODE_W5500) { n = 0; junk = false; return; }
    uint32_t w = rx_written();
    if (w - rx_rd > RX_WORDS) rx_rd = w - RX_WORDS / 2;
    for (; rx_rd != w; rx_rd++) {
        uint32_t wd = rx_ring[rx_rd & (RX_WORDS - 1)];
        last = now;
        uint8_t c = rx_ok(wd) ? rx_decode(wd) : 0;
        if (c == '\r') continue;
        if (c == '\n' || n >= sizeof line - 1) {
            if (!junk && n >= 3 && sd_link_up) {
                if (now - sent_t > 1000000u) { sent_t = now; sent_n = 0; }
                if (sent_n++ < 40) { line[n] = 0; status("dc console: %s", line); }
            }
            n = 0; junk = false;
            continue;
        }
        if (c < 0x20 || c > 0x7E) { junk = true; continue; }
        line[n++] = (char)c;
    }
    if (n && now - last > 200000u) {               /* text without a newline */
        if (!junk && n >= 3 && sd_link_up) { line[n] = 0; status("dc console: %s", line); }
        n = 0; junk = false;
    }
}

/* ---- W5500 <-> USB network (CDC-NCM) ----------------------------------- */
static bool net_rx_retry;
static uint32_t net_in, net_in_drop, net_out, net_in_full;

bool tud_network_recv_cb(const uint8_t *src, uint16_t size) {
    if (dc_mode != MODE_W5500 || !w5.sock_open) {
        net_in_drop++;
        net_rx_retry = true;
        return true;
    }
    if (w5_net_rx(src, size)) {
        net_in++;
        net_rx_retry = true;          /* accepted (or dropped): ask for the next one */
        return true;
    }
    net_in_full++;
    net_rx_retry = true;              /* buffer full: retry later */
    return false;
}

uint16_t tud_network_xmit_cb(uint8_t *dst, void *ref, uint16_t arg) {
    (void)arg;
    w5_txd_t *d = (w5_txd_t *)ref;
    uint16_t n = d->len;
    w5_net_tx_copy(d, dst);
    w5_net_tx_pop();
    net_out++;
    return n;
}

void tud_network_init_cb(void) { }

static void net_task(void) {
    w5.link_up = tud_mounted();
    w5_txd_t *d = w5_net_tx_peek();
    if (d) {
        if (!tud_mounted()) w5_net_tx_pop();          /* nobody to send to */
        else if (tud_network_can_xmit(d->len)) tud_network_xmit(d, 0);
    }
    if (net_rx_retry) {
        net_rx_retry = false;
        tud_network_recv_renew();
    }
}

/* ---- status lines for the Pi (logged by dcsd: journalctl -u dcsd) -------- */
#include <stdio.h>
#include <stdarg.h>
static void status(const char *fmt, ...) {
    char t[200];
    va_list ap; va_start(ap, fmt);
    int n = vsnprintf(t + 2, sizeof t - 2, fmt, ap);
    va_end(ap);
    if (n < 0) return;
    if (n > (int)sizeof t - 3) n = sizeof t - 3;
    if (!sd_link_up) return;
    t[0] = 'S'; t[1] = (char)n;
    host_write(t, (uint32_t)n + 2);
    tud_vendor_write_flush();
}

/* ---- hello + pin/heartbeat report while the cable is offline --------------- */
static void force_task(void) {
    uint8_t r = force_req;
    if (r == 0xFF) return;
    force_req = 0xFF;
    if (r > FORCE_SD) r = FORCE_AUTO;
    static const char *const names[] = { "auto", "serial only", "SPI (W5500 + SD)", "W5500 only", "SD only" };
    if (r != dc_force) status("mode setting from the Pi: %s", names[r]);
    dc_force = r;
}

/* ---- logic-analyzer capture (dcsd-capture on the Pi) ----------------------
   CLK/MOSI/MISO/CS sampled at 50 MHz into a 32 KiB ring (1.3 ms), running from
   the first rising SPI clock after arming. Once the driver is past its probe
   (5+ common-register frames) it stops when the bus has been quiet for 300 us,
   so the window holds the last ~1 ms before the DC stopped talking; otherwise
   it stops after 60 s and keeps the last 1.3 ms. Sent to the Pi as 'L' len:u16 data chunks (oldest
   sample first), ending with a zero-length chunk; dcsd decodes the SPI frames. */
#if DC_DIAG
#define CAP_BYTES  32768u
#define CAP_WORDS  (CAP_BYTES / 4)
static uint32_t cap_buf[CAP_WORDS] __attribute__((aligned(CAP_BYTES)));
static int cap_dma = -1;
static uint cap_sm = 1, cap_off;
static enum { CAP_IDLE, CAP_ARMED, CAP_SEND } cap_state;
static uint32_t cap_sent, cap_armed_at, cap_start, cap_seen_w5;
static float cap_mhz;

static void cap_init(void) {
    pio_sm_claim(pio1, cap_sm);
    cap_off = pio_add_program(pio1, &la_capture_program);
    pio_sm_config c = la_capture_program_get_default_config(cap_off);
    sm_config_set_in_pins(&c, PIN_DC_CTS_SENSE);
    sm_config_set_in_shift(&c, true, true, 32);
    sm_config_set_fifo_join(&c, PIO_FIFO_JOIN_RX);
    float div = (float)clock_get_hz(clk_sys) / 50e6f;
    if (div < 1.0f) div = 1.0f;
    sm_config_set_clkdiv(&c, div);
    cap_mhz = (float)clock_get_hz(clk_sys) / div / 1e6f;
    pio_sm_init(pio1, cap_sm, cap_off, &c);
    cap_dma = dma_claim_unused_channel(true);
}

static void cap_stop(const char *why) {
    pio_sm_set_enabled(pio1, cap_sm, false);
    uint32_t wa = dma_hw->ch[cap_dma].write_addr;
    bool filled = dma_hw->ch[cap_dma].transfer_count < 0xFFFFFFFFu - CAP_WORDS;
    dma_channel_abort(cap_dma);
    cap_start = filled ? ((wa - (uint32_t)cap_buf) & (CAP_BYTES - 1)) : 0;
    status("capture stopped (%s), sending to the Pi", why);
    cap_state = CAP_SEND; cap_sent = 0;
}

static void capture_task(void) {
    uint32_t now = time_us_32();
    if (cap_req) {
        cap_req = false;
        pio_sm_set_enabled(pio1, cap_sm, false);
        dma_channel_abort(cap_dma);
        memset(cap_buf, 0xFF, sizeof cap_buf);
        pio_sm_clear_fifos(pio1, cap_sm);
        pio_sm_restart(pio1, cap_sm);
        pio_sm_exec(pio1, cap_sm, pio_encode_jmp(cap_off));
        /* start at an SPI clock (the window is a ring that stops after the probe,
           so the start point hardly matters) */
        pio_sm_exec(pio1, cap_sm, pio_encode_wait_gpio(true, PIN_DC_CTS_SENSE));
        dma_channel_config dc = dma_channel_get_default_config(cap_dma);
        channel_config_set_transfer_data_size(&dc, DMA_SIZE_32);
        channel_config_set_read_increment(&dc, false);
        channel_config_set_write_increment(&dc, true);
        channel_config_set_ring(&dc, true, 15);              /* 32 KiB write ring */
        channel_config_set_dreq(&dc, pio_get_dreq(pio1, cap_sm, false));
        dma_channel_configure(cap_dma, &dc, cap_buf, &pio1->rxf[cap_sm], 0xFFFFFFFFu, true);
        pio_sm_set_enabled(pio1, cap_sm, true);
        cap_state = CAP_ARMED; cap_armed_at = now;
        cap_seen_w5 = spi_stats.common_seq;
        status("capture armed: %.0f MHz ring of %lu samples; stops 300 us after the W5500 driver's init goes quiet (CLK now %d)",
               (double)cap_mhz, (unsigned long)(CAP_WORDS * 8), (int)gpio_get(PIN_DC_CTS_SENSE));
        return;
    }
    if (cap_state == CAP_ARMED) {
        /* The probe (reset, MR, version: 3 common-block frames) passes; stop
           once the driver's init after it has gone quiet for 300 us, so the
           window shows the last ~1 ms before the DC stopped talking. */
        if (spi_stats.common_seq - cap_seen_w5 >= 5 && now - spi_stats.last_t > 300) {
            cap_stop("W5500 init went quiet");
        } else if (now - cap_armed_at > 60000000u) {
            cap_stop("60 s without a W5500 register access, last 1.3 ms");
        }
        return;
    }
    if (cap_state != CAP_SEND || !sd_link_up) return;
    const uint8_t *p = (const uint8_t *)cap_buf;
    while (cap_sent < CAP_BYTES) {
        uint32_t off = (cap_start + cap_sent) & (CAP_BYTES - 1);
        uint32_t n = CAP_BYTES - cap_sent;
        if (n > 1024) n = 1024;
        if (n > CAP_BYTES - off) n = CAP_BYTES - off;
        if (tud_vendor_write_available() < n + 3) { tud_vendor_write_flush(); return; }
        uint8_t h[3] = { 'L', (uint8_t)n, (uint8_t)(n >> 8) };
        tud_vendor_write(h, 3);
        tud_vendor_write(p + off, n);
        cap_sent += n;
    }
    if (tud_vendor_write_available() < 8) return;
    uint32_t khz = (uint32_t)(cap_mhz * 1000.0f + 0.5f);
    uint8_t e[7] = { 'L', 0, 0, (uint8_t)khz, (uint8_t)(khz >> 8), (uint8_t)(khz >> 16), (uint8_t)(khz >> 24) };
    tud_vendor_write(e, 7);
    tud_vendor_write_flush();
    cap_state = CAP_IDLE;
}
#else
static void cap_init(void) { }
static void capture_task(void) {
    if (!cap_req || !sd_link_up) return;
    cap_req = false;
    status("logic capture is not in this build (DC_DIAG=0)");
}
#endif

static void hello_task(void) {
    static bool said;
    static uint32_t last, beat0;
    uint32_t now = time_us_32();
    if (!sd_link_up) { said = false; return; }
    if (!said) {
        said = true; last = now; beat0 = core1_beat;
        static const char *const names[] = { "serial", "SPI (SD/W5500)", "offline" };
#ifndef DC_VERSION
#define DC_VERSION "dev"
#endif
        status("DC-PicoLink firmware " DC_VERSION " (" __DATE__ " " __TIME__ ") ready; mode %s; VERSIONR on the wire %02x; power sense %s",
               names[dc_mode], w5.common[W5C_VERSIONR],
               DC_POWER_PIN < 0 ? "off (DC_POWER_PIN=-1)" : dc_sense ? "wire in use" : "wire not seen (auto)");
        return;
    }
    if (dc_mode != MODE_OFFLINE || now - last < 10000000u) return;
    uint32_t in = gpio_get_all();
    status("offline: waiting for the DC (needs %s). pins CLK=%lu TXD=%lu RXD=%lu RTS=%lu CTSout=%lu; core1 %s",
           dc_sense ? "3.3 V on the sense wire" : "TXD or RTS high",
           (unsigned long)(in >> 2 & 1), (unsigned long)(in >> 3 & 1), (unsigned long)(in >> 4 & 1),
           (unsigned long)(in >> 5 & 1), (unsigned long)(in >> 6 & 1),
           core1_beat != beat0 ? "running" : "STUCK");
    beat0 = core1_beat; last = now;
}

/* ---- SPI / W5500 diagnostics ----------------------------------------------- */
static void spi_report(void) {
    static uint32_t last, sig;
    uint32_t now = time_us_32();
    if (now - last < 5000000u) return;
    uint32_t s = spi_stats.w5_frames * 3u + spi_stats.sd_frames * 5u + net_in * 7u + net_out * 11u + spi_stats.book_lost * 29u +
                 spi_stats.late_frames * 37u + spi_stats.underruns * 41u + w5.n_recv_bad * 43u +
                 w5.n_open * 17u + w5.n_send * 19u + w5.n_recv * 23u;
#if DC_DIAG
    s += spi_stats.cap_n * 31u;
#endif
    if (s == sig) return;
    sig = s; last = now;
    const uint8_t *mac = &w5.common[W5C_SHAR];
    status("spi: %lu W5500 frames, %lu SD frames, switches to SD %lu / to W5500 %lu; W5500 version reads %lu, other common reads %lu; SD %s",
           (unsigned long)spi_stats.w5_frames, (unsigned long)spi_stats.sd_frames,
           (unsigned long)spi_stats.to_sd, (unsigned long)spi_stats.to_w5,
           (unsigned long)spi_stats.ver_reads, (unsigned long)spi_stats.other_reads,
           spi_stats.sd_locked ? "off (a game opened the W5500 socket)" : "allowed (loader)");
    status("w5500: socket0 opens %lu (last mode %02x, now SR %02x), closes %lu, MAC %02x:%02x:%02x:%02x:%02x:%02x, SEND %lu, RECV %lu",
           (unsigned long)w5.n_open, w5.last_open_mr, w5.sreg[0][W5S_SR], (unsigned long)w5.n_close,
           mac[0], mac[1], mac[2], mac[3], mac[4], mac[5], (unsigned long)w5.n_send, (unsigned long)w5.n_recv);
#if DC_DIAG
    static uint32_t cap_seq_done, cap_shown;
    if (spi_stats.cap_seq != cap_seq_done) { cap_seq_done = spi_stats.cap_seq; cap_shown = 0; }
    uint32_t cn = spi_stats.cap_n;
    while (cap_shown < cn) {
        char line[200]; int o = snprintf(line, sizeof line, "spi frames %lu-:", (unsigned long)cap_shown);
        for (uint32_t i = cap_shown; i < cn && i < cap_shown + 3 && o < 150; i++) {
            typeof(spi_stats.cap[0]) *f = (void *)&spi_stats.cap[i];
            o += snprintf(line + o, sizeof line - o, " [%04x %02x n%u d%02x%02x miso%02x%s +%uus]",
                          f->addr, f->b2, f->words, f->d0, f->d1, f->miso,
                          (f->late & 2) ? " CUT" : (f->late & 1) ? " LATE" : "", f->dt_us);
        }
        status("%s", line);
        cap_shown = cap_shown + 3 < cn ? cap_shown + 3 : cn;
    }
#endif
    status("spi: %lu short/aborted frames (CS rose inside the header or a byte), %lu reads answered late, %lu burst underruns (MISO byte went out as ff), %lu RX resyncs (bad RECV pointer, buffered frames dropped)",
           (unsigned long)spi_stats.short_frames,
           (unsigned long)spi_stats.late_frames, (unsigned long)spi_stats.underruns, (unsigned long)w5.n_recv_bad);
    static uint8_t rsd_shown;
    if (w5.n_rsd < rsd_shown) rsd_shown = 0;                /* new session (reset) */
    for (; rsd_shown < w5.n_rsd; rsd_shown++) {
        typeof(w5.rsd[0]) *q = (void *)&w5.rsd[rsd_shown];
        uint16_t b = (uint16_t)q->base;
        status("RX resync %u: %s. DC wrote RX_RD %04x; read position %04x, data up to %04x (%lu bytes waiting); "
               "the DC moved %d bytes; length header at that spot %04x",
               rsd_shown, q->why == 1 ? "RX_RD beyond the received data" : "RX_RD inside a frame (no sane length header)",
               q->rd, b, (uint16_t)q->wr, (unsigned long)(q->wr - q->base), (int16_t)(q->rd - b), q->hl);
    }
    if (spi_stats.book_lost)
        status("spi: %lu frame records lost (bookkeeping queue full): the counts above are too low",
               (unsigned long)spi_stats.book_lost);
#if DC_DIAG
    static uint32_t late_shown, late_seq;
    if (spi_stats.cap_seq != late_seq) { late_seq = spi_stats.cap_seq; late_shown = 0; }
    if (spi_stats.late_n > late_shown) {
        for (uint32_t i = late_shown; i < spi_stats.late_n; i++)
            status("late read %lu: [%04x bsb%u %s waiting%u] %u cyc addr->answer, %lu cyc since last frame end, %u loop passes, %u bookkeeping steps",
                   (unsigned long)i, spi_stats.late_dbg[i].addr, spi_stats.late_dbg[i].bsb,
                   spi_stats.late_dbg[i].path ? "busy" : "hdr", spi_stats.late_dbg[i].waiting, spi_stats.late_dbg[i].cyc,
                   (unsigned long)spi_stats.late_dbg[i].since, spi_stats.late_dbg[i].passes, spi_stats.late_dbg[i].booked);
        late_shown = spi_stats.late_n;
    }
#endif
    status("w5500: USB network %s; frames to Pi %lu, from Pi %lu (dropped while socket closed/not W5500: %lu, buffer-full waits %lu)",
           tud_mounted() ? "up" : "down", (unsigned long)net_out, (unsigned long)net_in,
           (unsigned long)net_in_drop, (unsigned long)net_in_full);
}

/* ---- follow the Dreamcast's real TX rate (auto-baud) --------------------- */
#ifndef DC_AUTOBAUD
#define DC_AUTOBAUD 1
#endif

static float snap_dc_rate(float r) {          /* SCIF: Pclk/(32 * 4^n * (N+1)) */
    float best = r, err = 0.02f;
    for (int n = 0; n < 4; n++) {
        float base = 50e6f / (32.0f * (float)(1 << (2 * n)));
        int k = (int)(base / r + 0.5f);
        for (int kk = k - 1; kk <= k + 1; kk++) {
            if (kk < 1 || kk > 256) continue;
            float c = base / (float)kk, e = fabsf(c - r) / r;
            if (e < err) { err = e; best = c; }
        }
    }
    return best;
}

/* ---- DC 3.3 V sense wire: found by itself ---------------------------------
   The wire (GPIO DC_POWER_PIN -> 10k -> SD adapter VDD) is optional. Once GPIO7
   has been high for 100 ms it is in use (core1's dc_alive() follows it) until the
   RP2040 loses power; see sense_model.h, also for the wire-gone fallback. */
static const char *sense_note;              /* for the log, sent once dcsd is there */
#if DC_POWER_PIN >= 0
#define SENSE_NOTE(t)    (sense_note = (t))
#include "sense_model.h"
#endif

static void power_sense_task(void) {
#if DC_POWER_PIN >= 0
    sense_step(time_us_32(), gpio_get_all());
#endif
}

static void sense_report_task(void) {
    if (!sense_note || !sd_link_up) return;
    status("power sense GPIO%d: %s", DC_POWER_PIN, sense_note);
    sense_note = 0;
}

static void autobaud_task(void) {
    static uint32_t win[32], wn;
    static float cand;
    static uint32_t cand_n;
    static bool reported;
    static uint32_t fe_count, fe_last_report, fe_reported, fe_mark;
    static int last_mode = -1;
    uint32_t now = time_us_32();

    static uint32_t warned_baud;
    if (baud_wrapped && cur_baud != warned_baud && sd_link_up) {
        warned_baud = cur_baud;
        status("serial: host asked %lu baud; above 1562500 dcload's divider wraps and the DC runs at %.0f baud "
               "(the cable matches it). The DC's fastest rate is 1562500: use -b 1500000 or -b 1562500",
               (unsigned long)cur_baud, (double)wire_baud);
    }
    if (!baud_wrapped) warned_baud = 0;

    static uint32_t spi_since;
    if (seen_mode != last_mode) {             /* new DC session: forget everything */
        /* Forget the learned DC rate when the DC goes offline, or after a real SD
           session (> 1 s of SPI: a loader started another program, which sets its
           own speed). A short SPI blip keeps it. */
        bool forget = seen_mode == MODE_OFFLINE ||
                      (last_mode == MODE_W5500 && seen_mode == MODE_SERIAL && now - spi_since > 1000000u);
        if (seen_mode == MODE_W5500) spi_since = now;
        last_mode = seen_mode;
        wn = 0; cand = 0; reported = false;
        if (auto_baud != 0 && forget) {
            auto_baud = 0;
            set_wire_baud(dc_effective_baud(cur_baud));
            if (seen_mode == MODE_SERIAL) status("serial: new program after SD use, back to host speed %lu", (unsigned long)cur_baud);
        }
    }
    if (seen_mode != MODE_SERIAL) {
        while (!pio_sm_is_rx_fifo_empty(uart_pio, meter_sm)) (void)pio_sm_get(uart_pio, meter_sm);
        return;
    }
    fe_count = rx_fe_count;
    if (fe_count != fe_reported && now - fe_last_report > 5000000u) {
        status("serial: %lu framing errors from the DC so far (wire %.0f baud, host %lu)",
               (unsigned long)fe_count, (double)wire_baud, (unsigned long)cur_baud);
        fe_reported = fe_count; fe_last_report = now;
    }

#if DC_DIAG
    for (uint8_t i = 0; i < ppm_nrep; i++) status("serial: %s", ppm_rep[i]);
    if (ppm_nrep && ppm_rep_dropped) status("serial: (%lu more bad frames not shown)", (unsigned long)ppm_rep_dropped);
    if (ppm_nrep) { ppm_nrep = 0; ppm_rep_dropped = 0; }
    static uint32_t pp_last, pp_good, pp_bad;
    if ((ppm.good != pp_good || ppm.bad != pp_bad) && now - pp_last > 10000000u) {
        status("serial: PPP frames from the DC as received by the cable: %lu good, %lu bad checksum; "
               "split votes in %lu of %lu chars (%lu bits); %lu ring overruns",
               (unsigned long)ppm.good, (unsigned long)ppm.bad, (unsigned long)ppm.split_chars,
               (unsigned long)ppm.chars, (unsigned long)ppm.split_bits, (unsigned long)rx_overruns);
        pp_good = ppm.good; pp_bad = ppm.bad; pp_last = now;
    }
#endif

    while (!pio_sm_is_rx_fifo_empty(uart_pio, meter_sm)) {
        uint32_t cyc = 2u * pio_sm_get(uart_pio, meter_sm) + 4u;
        if (cyc < 40u) continue;                       /* glitch */
        win[wn++] = cyc;
        if (wn < 32) continue;
        wn = 0;
        if (!abw_usable(win, 32)) continue;            /* all pulses equal: a run of zero bytes looks like a slow DC */
        uint32_t m = 0xFFFFFFFFu;
        for (int i = 0; i < 32; i++) if (win[i] < m) m = win[i];
        uint64_t sum = 0; uint32_t cnt = 0;
        for (int i = 0; i < 32; i++) if (win[i] <= m + m / 3) { sum += win[i]; cnt++; }
        if (cnt < 4) continue;
        float bit = (float)sum / (float)cnt;
        uint32_t fit = 0;                              /* pulses ~ whole bit counts? */
        for (int i = 0; i < 32; i++) {
            float q = (float)win[i] / bit, f = q - (float)(int)(q + 0.5f);
            if (fabsf(f) < 0.2f) fit++;
        }
        if (fit < 26) continue;
        float rate = (float)clock_get_hz(clk_sys) / bit;
        float snapped = snap_dc_rate(rate);
        if (!reported) {
            status("serial: DC transmits at ~%.0f baud (nearest SCIF rate %.0f); wire %.0f, host asked %lu",
                   (double)rate, (double)snapped, (double)wire_baud, (unsigned long)cur_baud);
            reported = true;
        }
#if DC_AUTOBAUD
        /* Follow the DC when the current speed is off by more than 2.5%:
           - right away (2 agreeing windows) if framing errors show it's wrong;
           - otherwise only after 4 agreeing windows with plenty of 1-bit pulses
             (a mis-measured window can't re-tune a working link).
           At 4% off (115200 vs the DC's 120192) most bytes still decode, but ~1%
           are damaged: enough to lose most large PPP frames. */
        float off = fabsf(rate / wire_baud - 1.0f);
        if (off < 0.025f || rate > 400000.0f || wire_baud > 400000.0f) { cand = 0; cand_n = 0; continue; }
        if ((int32_t)(now - baud_holdoff_until) < 0) continue;
        bool clean = cnt >= 8;                         /* >= 25% single-bit pulses */
        /* framing errors are counted from the first window of this candidate on,
           so slow traffic (a game retrying "AT" once a second) still adds up */
        if (cand == 0 || fabsf(rate / cand - 1.0f) > 0.015f) { cand = rate; cand_n = 1; fe_mark = fe_count; continue; }
        cand_n++;
        bool errors = fe_count != fe_mark;
        if (ab_fraction(wire_baud, rate) && cand_n < 16) continue;     /* 1/2, 1/3 ... of the wire rate: be sure first */
        if (!(errors && cand_n >= 2) && !(clean && cand_n >= 4)) continue;
        auto_baud = snapped;
        set_wire_baud(snapped);
        cand = 0; cand_n = 0;
        status("serial: following the DC at %.0f baud (host asked %lu)", (double)snapped, (unsigned long)cur_baud);
#endif
    }
}

/* ---- SD card backend (dcsd on the Pi) ------------------------------------ */
static void sd_task(void) {
    /* No DTR on a vendor interface: the link is up while dcsd talks to us (it
       sends 'I' at start and every 2 s), and down after 5 s of silence. */
    static uint32_t last_rx;
    uint32_t now = time_us_32();
    if (!tud_mounted()) {
        if (sd_link_up) { sd_link_up = false; sdh_disconnected(); }
        return;
    }
    uint8_t buf[256];
    uint32_t n;
    while ((n = tud_vendor_available()) > 0) {
        if (n > sizeof buf) n = sizeof buf;
        n = tud_vendor_read(buf, n);
        if (!sd_link_up) { sd_link_up = true; sdh_connected(); }
        last_rx = now;
        sdh_rx(buf, n);
    }
    if (sd_link_up && now - last_rx > 5000000u) { sd_link_up = false; sdh_disconnected(); }
    if (sd_link_up) sdh_poll();
    tud_vendor_write_flush();
}

int main(void) {
#ifdef DC_SYS_KHZ
    /* optional overclock for more SPI reply headroom, e.g. -DDC_SYS_KHZ=250000 */
    vreg_set_voltage(VREG_VOLTAGE_1_20);
    busy_wait_us(1000);
    set_sys_clock_khz(DC_SYS_KHZ, true);
#endif
    serial_init();
    w5500_spi_init();
    cap_init();
    tusb_init();
    multicore_launch_core1(core1_main);
    while (true) {
        tud_task();
        track_mode();
        if (seen_mode == MODE_SERIAL) {
            usb_to_dc();
            dc_to_usb();
        } else {
            uint8_t junk[64];             /* serial port idle in W5500 mode */
            while (tud_cdc_available()) tud_cdc_read(junk, sizeof(junk));
        }
        net_task();
        spi_report();
        console_task();
        hello_task();
        force_task();
        capture_task();
        sd_task();
        autobaud_task();
        power_sense_task();
        sense_report_task();
    }
}
