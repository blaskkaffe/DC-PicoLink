## esp32/main/Kconfig.projbuild
```kconfig
menu "DC-PicoLink ESP32"
    choice DCL_LINK_WIRE
        prompt "Link to the cable"
        default DCL_LINK_UART
        config DCL_LINK_UART
            bool "UART (Pico / Pro Micro cable: cable GPIO12-15)"
        config DCL_LINK_SPI
            bool "SPI (RP2040-Zero stack: cable GPIO2-7; this board is the slave)"
    endchoice
    config DCL_LSPI_MOSI
        int "SPI link MOSI pin (from the cable's GPIO7)"
        depends on DCL_LINK_SPI
        default 6
    config DCL_LSPI_MISO
        int "SPI link MISO pin (to the cable's GPIO4)"
        depends on DCL_LINK_SPI
        default 3
    config DCL_LSPI_SCLK
        int "SPI link clock pin (from the cable's GPIO6)"
        depends on DCL_LINK_SPI
        default 5
    config DCL_LSPI_CS
        int "SPI link chip-select pin (from the cable's GPIO5)"
        depends on DCL_LINK_SPI
        default 4
    config DCL_LSPI_HS
        int "SPI link ready pin, HS (to the cable's GPIO3)"
        depends on DCL_LINK_SPI
        default 2
    config DCL_LSPI_DR
        int "SPI link data-ready pin, DR (to the cable's GPIO2)"
        depends on DCL_LINK_SPI
        default 1
    config DCL_LINK_TX
        int "Link TX pin (to the cable's GPIO13)"
        depends on DCL_LINK_UART
        default 5
    config DCL_LINK_RX
        int "Link RX pin (from the cable's GPIO12)"
        depends on DCL_LINK_UART
        default 6
    config DCL_LINK_RTS
        int "Link RTS pin (to the cable's GPIO14, CTS)"
        depends on DCL_LINK_UART
        default 7
    config DCL_LINK_CTS
        int "Link CTS pin (from the cable's GPIO15, RTS)"
        depends on DCL_LINK_UART
        default 8
    config DCL_AP_PASSWORD
        string "Password of the setup Wi-Fi (8+ characters, empty = open)"
        default "dreamcast"
    config DCL_USB_MODEM
        bool "USB modem on this board's USB socket (the Dreamcast's own modem calls it, as with a DreamPi)"
        default n
        help
            The board becomes the USB host. Its USB console is gone then: use sdkconfig.modem,
            which moves the console to UART0. To flash, hold BOOT while plugging in.
    config DCL_W5500
        bool "Wired Ethernet port: a W5500 module on the ESP32's own SPI pins"
        default y
        help
            Found by itself at start; without a module the port stays off. With a cable plugged
            in, the port is the uplink (a router answers DHCP) or the socket for the Dreamcast's
            broadband adapter (nobody answers).
    config DCL_W5500_SCLK
        int "W5500 clock pin"
        depends on DCL_W5500
        default 12
    config DCL_W5500_MOSI
        int "W5500 MOSI pin"
        depends on DCL_W5500
        default 11
    config DCL_W5500_MISO
        int "W5500 MISO pin"
        depends on DCL_W5500
        default 13
    config DCL_W5500_CS
        int "W5500 chip-select pin"
        depends on DCL_W5500
        default 10
    config DCL_W5500_INT
        int "W5500 interrupt pin (-1: none, poll every 5 ms)"
        depends on DCL_W5500
        default 9
    config DCL_W5500_MHZ
        int "W5500 SPI clock in MHz"
        depends on DCL_W5500
        default 20
endmenu
```
